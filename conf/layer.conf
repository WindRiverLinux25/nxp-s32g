## conf/machine/nxp-s32g.conf
```bitbake
#@TYPE: Machine
#@NAME: nxp-s32g
#@DESCRIPTION: Machine configuration for NXP S32G2/G3 SoC

DEFAULTTUNE = "cortexa53"
require conf/machine/include/arm/armv8a/tune-cortexa53.inc

require conf/machine/include/llce.inc
require conf/machine/include/ipcf.inc
require conf/machine/include/hse.inc
require conf/machine/include/srm.inc

MACHINE_FEATURES = "ext3 pci usbgadget usbhost vfat"

KERNEL_IMAGETYPE = ""
KERNEL_IMAGETYPES = " ${@bb.utils.contains('ATF_SIGN_ENABLE', '1', 'fitImage Image', 'Image.gz Image', d)}"
KERNEL_CLASSES = "${@bb.utils.contains('ATF_SIGN_ENABLE', '1', ' kernel-fitimage', ' ', d)}"

DTB_FILES = "s32g2xxa-evb.dtb s32g274a-rdb2.dtb s32g399a-rdb3.dtb s32g3xxa-evb.dtb \
             s32g2xxa-evb-pfems.dtb s32g274a-rdb2-pfems.dtb s32g399a-rdb3-pfems.dtb s32g3xxa-evb-pfems.dtb"

KERNEL_DEVICETREE = "${@''.join('freescale/%s ' % d for d in '${DTB_FILES}'.split())}"

SERIAL_CONSOLES ?= "115200;ttyLF0"
SERIAL_CONSOLES_CHECK ?= "${SERIAL_CONSOLES}"

IMAGE_FSTYPES += "tar.bz2"

# multilib support
MULTILIBS ?= "multilib:lib32"
DEFAULTTUNE:virtclass-multilib-lib32 ?= "armv7athf-neon"
EXTRA_IMAGECMD:jffs2 = "--pad --no-cleanmarkers --eraseblock=128"

#currently, non-s32g bsp and secure boot only support sdcard as boot device
BOOT_TYPE = "sd qspi"

UBOOT_CONFIG ??= "s32g274ardb2 s32g2xxaevb s32g399ardb3 s32g3xxaevb \
                  s32g274ardb2_qspi s32g2xxaevb_qspi s32g399ardb3_qspi s32g3xxaevb_qspi"

UBOOT_CONFIG[s32g2xxaevb] = "s32g2xxaevb_defconfig"
UBOOT_CONFIG[s32g274ardb2] = "s32g274ardb2_defconfig"
UBOOT_CONFIG[s32g399ardb3] = "s32g399ardb3_defconfig"
UBOOT_CONFIG[s32g3xxaevb] = "s32g3xxaevb_defconfig"
UBOOT_CONFIG[s32g2xxaevb_qspi] = "s32g2xxaevb_qspi_defconfig"
UBOOT_CONFIG[s32g274ardb2_qspi] = "s32g274ardb2_qspi_defconfig"
UBOOT_CONFIG[s32g399ardb3_qspi] = "s32g399ardb3_qspi_defconfig"
UBOOT_CONFIG[s32g3xxaevb_qspi] = "s32g3xxaevb_qspi_defconfig"

UBOOT_MAKE_TARGET ?= "all"
UBOOT_BINARY = "u-boot-nodtb.bin"
UBOOT_CFGOUT = "u-boot-s32.cfgout"
PREFERRED_VERSION_u-boot-s32 ?= "2022.04"
PREFERRED_PROVIDER_u-boot-tools-native = "u-boot-tools-native"
PREFERRED_VERSION_u-boot-tools ?= "2022.04-s32"
PREFERRED_PROVIDER_virtual/bootloader = "u-boot-s32"
PREFERRED_PROVIDER_u-boot = "u-boot-s32"
BB_MULTI_PROVIDER_ALLOWED += "virtual/bootloader"

MACHINE_EXTRA_RRECOMMENDS = " kernel-modules kernel-devicetree"
IMAGE_FSTYPES += "tar.bz2 wic wic.bmap"
WKS_FILE ?= "${@bb.utils.contains('DISTRO_FEATURES', 'dm-verity', 's32g-sdimage-dmverity.wks.in', 's32g-sdimage-bootpart.wks', d)}"
IMAGE_INSTALL:append = " ${@bb.utils.contains('ATF_SIGN_ENABLE', '1', 'kernel-devicetree kernel-image-fitimage', 'kernel-devicetree kernel-image-image', d)}"
do_image_wic[depends] += "mtools-native:do_populate_sysroot dosfstools-native:do_populate_sysroot"

IMAGE_BOOT_FILES:append = " ${@bb.utils.contains('IMAGE_INSTALL', 'pfe', 's32g_pfe_class.fw s32g_pfe_util.fw', '', d)}"
IMAGE_BOOT_FILES:append = " ${@bb.utils.contains('IMAGE_INSTALL', 'ipc-shm', '${IPCF_M7_APP_BIN_NAME}', '', d)}"
IMAGE_BOOT_FILES:append = " ${@bb.utils.contains('IMAGE_INSTALL', 'ipc-shm', '${IPCF_M7_APP_BIN_NAME_S32G3}', '', d)}"

PREFERRED_PROVIDER_virtual/kernel ??= "linux-yocto"
PREFERRED_VERSION_linux-yocto ?= "6.12%"

PREFERRED_VERSION_optee-os ?= "4.0.0"
PREFERRED_VERSION_optee-client ?= "4.0.0"
PREFERRED_VERSION_optee-test ?= "4.0.0"
PREFERRED_VERSION_optee-examples ?= "4.0.0"
PREFERRED_VERSION_optee-os-tadevkit ?= "4.0.0"
RELEASE_BASE ?= "release/bsp43.0"
DEFAULT_TADEVKIT_VARIANT ?= "s32g2"
DEFAULT_ARMTZ_VARIANT ?= "s32g2"
OPTEE_PLAT_FLAVORS = "s32g2 s32g3"
NON_MULTILIB_RECIPES:append = " optee-os"
NON_MULTILIB_RECIPES:append = " optee-test"
NON_MULTILIB_RECIPES:append = " optee-client"
NON_MULTILIB_RECIPES:append = " optee-os-tadevkit"
NON_MULTILIB_RECIPES:append = " optee-examples"

# For ostree
INITRAMFS_IMAGE ??= ""
INITRAMFS_FSTYPES:append = " ${@bb.utils.contains('ATF_SIGN_ENABLE', '1', 'cpio.gz', '', d)}"
INITRAMFS_FITIMAGE ??= "${@bb.utils.contains('ATF_SIGN_ENABLE', '1', 'fitImage-${INITRAMFS_IMAGE}-${MACHINE}-${MACHINE}', '', d)}"
RAMDISK_EXT = ".cpio.gz.u-boot"
IMAGE_BOOT_FILES:append = " ${@bb.utils.contains('DISTRO_FEATURES', 'ostree', '${INITRAMFS_IMAGE}-${MACHINE}${RAMDISK_EXT};initramfs \
				boot.scr ${INITRAMFS_FITIMAGE}', '', d)}"
OSTREE_KERNEL ?= "${@bb.utils.contains('ATF_SIGN_ENABLE', '1', 'fitImage-${INITRAMFS_IMAGE}-${MACHINE}-${MACHINE}', 'Image', d)}"

SKIP_SCRIPT_FDT ?= "yes"

SET_FITIMAGE_LOADADDR ?= " ${@bb.utils.contains('ATF_SIGN_ENABLE', '1', 'setenv load_fitimage_addr 0xE0000000', '', d)}"

BOOTCMD_SECURE_BOOT ?= " \
${SET_FITIMAGE_LOADADDR}; \
mmc read \$loadaddr 8 1; \
setexpr secure_mode \$loadaddr + 0x28; \
if itest.b *\$secure_mode != 9; then \
  if fatsize mmc 0 rsa2048_public.der; then \
    hse_secboot_enable rsa2048_public.der; reset; \
  fi; \
fi;"

OSTREE_BOOTSCR_PRECMD ?= " \
${@bb.utils.contains('IMAGE_INSTALL', 'pfe', 'pfeng stop;', '', d)} \
setenv initrd_addr 0x85010000; \
setenv use_fdtdtb ${@oe.utils.conditional('OSTREE_USE_FIT', '1', '0', '1', d)}; \
setenv skip_script_fdt ${SKIP_SCRIPT_FDT}; \
${@oe.utils.conditional('ATF_SIGN_ENABLE', '1', '${BOOTCMD_SECURE_BOOT}', '', d)} \
"

# u-boot will set the correct fdt_file according to the boards
DEFAULT_DTB ?= ""

OSTREE_COPY_IMAGE_BOOT_FILES = "1"
OSTREE_UBOOT_CMD ?= "booti"

# For ustart.img
OSTREE_NETINST_DEV ?= "/dev/mmcblk0,/dev/sda,/dev/vda"
OSTREE_NETINST_ARGS ?= "${OSTREE_CONSOLE} bl=ufsd rdinit=/install instdev=${OSTREE_NETINST_DEV} instname=wrlinux instbr=\$BRANCH insturl=\$URL instab=${OSTREE_USE_AB} instsf=1 instdate=BUILD_DATE"

# # The loader is flashed into the device separately
OSTREE_SD_UBOOT_WIC1 ?= ""
OSTREE_SD_UBOOT_WIC2 ?= ""
OSTREE_SD_UBOOT_WIC3 ?= ""
OSTREE_SD_UBOOT_WIC4 ?= ""
# Reserve 10MB disk as boot loader block offset for atf bootloader
OSTREE_SD_BOOT_ALIGN ?= "10240"
OSTREE_FDISK_BLM ?= "20480"

OSTREE_INITRAMFS_INSTALL += "${@bb.utils.contains('IMAGE_INSTALL', 'pfe', 'pfe', '', d)}"

# Add vault support
VAULT_ENABLE ??= "0"

require s32g-boot-file.inc
```
